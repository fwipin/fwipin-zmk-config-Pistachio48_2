## boards/shields/Pistachio48/Kconfig.defconfig
```kconfig
if SHIELD_PISTACHIO48_L

config ZMK_KEYBOARD_NAME
    default "Pistachio48_L"

config ZMK_SPLIT
    default y

config ZMK_SPLIT_ROLE_CENTRAL
    default y
    
endif

if SHIELD_PISTACHIO48_R

config ZMK_KEYBOARD_NAME
    default "Pistachio48_R"

config ZMK_SPLIT
    default y

endif
```

## boards/shields/Pistachio48/Kconfig.shield
```kconfig
config SHIELD_PISTACHIO48_L
    def_bool $(shields_list_contains,Pistachio48_L)

config SHIELD_PISTACHIO48_R
    def_bool $(shields_list_contains,Pistachio48_R)
```
